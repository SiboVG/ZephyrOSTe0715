/*
 * TE0701 carrier: SPI1 on Pmod J1, for one SPI sensor at a time (the INA229 or the
 * ADXL355 bench):
 *
 *   Pmod J1 pin 8  = MIO10 = MOSI (sensor SDI)
 *   Pmod J1 pin 9  = MIO11 = MISO (sensor SDO)
 *   Pmod J1 pin 10 = MIO12 = SCLK
 *   Pmod J1 pin 7  = MIO13 = SS0, the controller's own chip select, active low
 *
 * The chip select is the controller's SS0 (native, slave 0), not a GPIO: see
 * te0715-pinctrl.dtsi. MIO12/13 are also CAN1 (te0701-can1.overlay): use one overlay
 * or the other. MIO10/11 also reach the TE0701 CPLD; see docs/tests/spi-sensors.md.
 */

&spi1 {
	status = "okay";
};
