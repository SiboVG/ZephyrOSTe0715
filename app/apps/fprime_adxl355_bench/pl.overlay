/*
 * SPDX-License-Identifier: Apache-2.0
 *
 * PL devices of the cubespec-pl pp bitstream, generated by cubespec-pl into
 * sw/dts/pp-pl.dtsi (DTS_ROOT set in CMakeLists.txt). The nodes only describe the
 * registers: nothing touches them unless a `pl` command or `adxl stream start-pl`
 * does, which needs the bitstream loaded.
 */

#include <pp-pl.dtsi>
