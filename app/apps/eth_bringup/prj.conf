## CMakeLists.txt
```
# SPDX-License-Identifier: Apache-2.0

cmake_minimum_required(VERSION 3.20.0)

# Out-of-tree te0715 board, and its MAC address for images with networking
list(APPEND BOARD_ROOT ${CMAKE_CURRENT_SOURCE_DIR}/../..)
list(APPEND EXTRA_DTC_OVERLAY_FILE ${CMAKE_CURRENT_SOURCE_DIR}/../../boards/te0715-mac.overlay)

find_package(Zephyr REQUIRED HINTS $ENV{ZEPHYR_BASE})
project(eth_bringup)

target_sources(app PRIVATE src/main.c)
```

## Kconfig
```
# SPDX-License-Identifier: Apache-2.0

mainmenu "Ethernet bring-up on the TE0715"

config APP_BOOT_TRACE
	bool "Print a line at each initialization level"
	help
	  For diagnosing a boot that stops before the banner: prints
	  [ETH_BRINGUP_TRACE] lines at PRE_KERNEL_2, at the start and end of
	  POST_KERNEL (before and after the drivers and the network stack)
	  and at APPLICATION. Enabled by debug.conf.

source "Kconfig.zephyr"
```

## prj.conf
```kconfig
# Ethernet on GEM0 with a static IPv4 address (TE-ETH-002, TC-24)
CONFIG_NETWORKING=y
CONFIG_NET_L2_ETHERNET=y
CONFIG_NET_IPV4=y
CONFIG_NET_IPV6=n
CONFIG_NET_TCP=n
CONFIG_NET_UDP=y
CONFIG_NET_CONFIG_SETTINGS=y
CONFIG_NET_CONFIG_NEED_IPV4=y
CONFIG_NET_CONFIG_MY_IPV4_ADDR="192.168.70.2"
CONFIG_NET_CONFIG_MY_IPV4_NETMASK="255.255.255.0"
CONFIG_NET_CONFIG_PEER_IPV4_ADDR="192.168.70.1"

# Packets and buffers for full 1514-byte frames in both directions: one frame
# takes 12 buffers of the default 128 bytes
CONFIG_NET_PKT_RX_COUNT=32
CONFIG_NET_PKT_TX_COUNT=32
CONFIG_NET_BUF_RX_COUNT=128
CONFIG_NET_BUF_TX_COUNT=128

# The stack needs random numbers (e.g. ping identifiers). The Zynq-7000 has no
# entropy driver; the timer-based generator is not secure, which is acceptable
# for a bring-up image without TCP or TLS.
CONFIG_TEST_RANDOM_GENERATOR=y
CONFIG_TIMER_RANDOM_GENERATOR=y

# Serial shell: net iface/ping/stats, and kernel reboot for uboot_load.py
CONFIG_SHELL=y
CONFIG_NET_SHELL=y
CONFIG_KERNEL_SHELL=y
CONFIG_REBOOT=y
CONFIG_NET_STATISTICS=y

# Logs and printk straight to the UART, also before the shell is up: with the
# shell's log backend, messages before the shell starts (a fault during driver
# initialization included) would never appear
CONFIG_PRINTK=y
CONFIG_LOG=y
CONFIG_SHELL_LOG_BACKEND=n
CONFIG_LOG_BACKEND_UART=y
CONFIG_MAIN_STACK_SIZE=4096
```

## debug.conf
```kconfig
# Diagnosis of a boot that stops early:
#   west build -b te0715 app/apps/eth_bringup -d build/eth_debug -- -DEXTRA_CONF_FILE=debug.conf
CONFIG_APP_BOOT_TRACE=y
# Log messages printed when they happen, also from driver initialization and faults
CONFIG_LOG_MODE_IMMEDIATE=y
CONFIG_ETHERNET_LOG_LEVEL_DBG=y
# printk straight to the console, also before the log backend starts (PRE_KERNEL_2)
CONFIG_LOG_PRINTK=n
```

## mac.overlay
```dts
/*
 * A locally administered, unicast MAC address for the bring-up image, the one
 * uboot_eth_check.py also uses. The module's own address (from its EEPROM, which
 * U-Boot reads) is not available to Zephyr yet. Use it only on a link without
 * another TE0715 running this image.
 */
&gem0 {
    local-mac-address = [02 00 00 07 15 01];
};
```

## src/main.c
```c
/*
 * Ethernet bring-up for the TE0715 on a TE0701 (TE-ETH-002, TC-24):
 * - the interface comes up with the static IPv4 address of prj.conf;
 * - the image waits up to LINK_TIMEOUT_MS for the carrier and prints one line,
 *   [ETH_BRINGUP_READY] carrier=on|off mac=... ipv4=... waited_ms=...;
 * - the network shell (net iface, net ping, net stats) and the kernel shell
 *   (kernel reboot cold, used by uboot_load.py) stay available;
 * - a fatal error, once printed, reboots the board instead of halting it: the
 *   board boots its SD card image again, whose shell lets the next image be
 *   loaded without a hand on the reset button.
 */

#include <zephyr/fatal.h>
#include <zephyr/kernel.h>
#include <zephyr/logging/log_ctrl.h>
#include <zephyr/net/net_if.h>
#include <zephyr/net/net_ip.h>
#include <zephyr/sys/printk.h>
#include <zephyr/sys/reboot.h>

#define LINK_TIMEOUT_MS 10000
#define LINK_POLL_MS    100

#if defined(CONFIG_APP_BOOT_TRACE)
#include <zephyr/init.h>

#define BOOT_TRACE(level, prio, text)                                                          \
	static int boot_trace_##level##_##prio(void)                                           \
	{                                                                                      \
		printk("[ETH_BRINGUP_TRACE] " text "\n");                                     \
		return 0;                                                                      \
	}                                                                                      \
	SYS_INIT(boot_trace_##level##_##prio, level, prio)

BOOT_TRACE(PRE_KERNEL_2, 0, "pre-kernel-2");
BOOT_TRACE(POST_KERNEL, 0, "post-kernel: before the drivers");
BOOT_TRACE(POST_KERNEL, 99, "post-kernel: drivers and network stack initialized");
BOOT_TRACE(APPLICATION, 0, "application");
#endif

void k_sys_fatal_error_handler(unsigned int reason, const struct arch_esf *esf)
{
	ARG_UNUSED(esf);

	LOG_PANIC();
	printk("[ETH_BRINGUP_FATAL] reason=%u: rebooting\n", reason);
	sys_reboot(SYS_REBOOT_COLD);
}

int main(void)
{
	struct net_if *iface = net_if_get_default();
	char mac[sizeof("xx:xx:xx:xx:xx:xx")] = "?";
	char ipv4[NET_IPV4_ADDR_LEN] = "none";
	uint32_t waited = 0U;

	if (iface == NULL) {
		printk("[ETH_BRINGUP_READY] carrier=off mac=? ipv4=none waited_ms=0 (no interface)\n");
		return 0;
	}

	while (!net_if_is_carrier_ok(iface) && waited < LINK_TIMEOUT_MS) {
		k_msleep(LINK_POLL_MS);
		waited += LINK_POLL_MS;
	}

	const struct net_linkaddr *link = net_if_get_link_addr(iface);

	if (link->len == 6U) {
		snprintk(mac, sizeof(mac), "%02x:%02x:%02x:%02x:%02x:%02x", link->addr[0],
			 link->addr[1], link->addr[2], link->addr[3], link->addr[4],
			 link->addr[5]);
	}

	const struct net_in_addr *addr = net_if_ipv4_get_global_addr(iface, NET_ADDR_PREFERRED);

	if (addr != NULL) {
		(void)net_addr_ntop(NET_AF_INET, addr, ipv4, sizeof(ipv4));
	}

	printk("[ETH_BRINGUP_READY] carrier=%s mac=%s ipv4=%s waited_ms=%u\n",
	       net_if_is_carrier_ok(iface) ? "on" : "off", mac, ipv4, waited);
	return 0;
}
```
