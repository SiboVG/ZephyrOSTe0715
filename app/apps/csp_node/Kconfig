## app/apps/csp_node/Kconfig
```kconfig
# SPDX-License-Identifier: Apache-2.0

mainmenu "TE0715 CSP node"

config APP_CSP_NODE
	int "Local CSP node address"
	range 1 16381
	default 101

config APP_CSP_PEER
	int "CSP node to ping (0: do not ping)"
	range 0 16381
	default 100

config APP_CSP_NETMASK
	int "CSP network prefix length"
	range 0 13
	default 8

config APP_CSP_PING_PERIOD_MS
	int "Ping period in milliseconds"
	default 2000

config APP_PARAM_ID
	int "ID of the libparam test parameter (bench_integer, uint32)"
	range 0 65535
	default 200

config APP_BENCH_VALUE
	hex "Initial value of the libparam test parameter"
	default 0x12345678

source "Kconfig.zephyr"
```

## app/apps/fprime_adxl355_bench/Kconfig
```kconfig
# SPDX-License-Identifier: Apache-2.0

mainmenu "ADXL355 bench on the TE0715"

config APP_SPI_FREQUENCY
	int "Requested SPI clock in Hz at boot"
	range 558035 10000000
	default 1200000
	help
	  The Zynq SPI controller divides SPI_REF_CLK (142.86 MHz) by 4 to 256;
	  the driver picks the fastest division that does not exceed this
	  request. 1.2 MHz selects 1.116 MHz. Change it at run time with
	  `adxl spi`.

config APP_SPI_MODE
	int "SPI mode at boot"
	range 0 3
	default 0
	help
	  The ADXL355 uses CPOL 0, CPHA 0 (data sheet, SPI protocol).

config APP_TIMING_THREAD_PRIORITY
	int "Zephyr priority of the frame timing thread"
	default 2
	help
	  The thread that triggers acquireFrame, standing in for the FPGA
	  synchronization source. It must preempt the F Prime tasks and the
	  shell.

source "Kconfig.zephyr"
```

## app/apps/fprime_csp_bench/Kconfig
```kconfig
# SPDX-License-Identifier: Apache-2.0

mainmenu "CSP/libparam bench server on the TE0715"

config APP_CSP_NODE
	int "Default CSP node address"
	range 1 16381
	default 6061
	help
	  Used unless another node is given with `bench start` on the serial
	  console during the start window. 6061 lies in the lab51 EGSE CAN
	  subnet 6016/8, next to the Ubuntu test host 6060.

config APP_CSP_NETMASK
	int "Default CSP network prefix length"
	range 0 13
	default 8

config APP_START_WINDOW_S
	int "Seconds to wait for `bench start` before using the defaults"
	default 10

config APP_CSP_ROUTER_PRIORITY
	int "F Prime priority of the CspRouter task"
	range 0 99
	default 45
	help
	  On F Prime's scale (higher is more important; Zephyr priority is
	  99 minus this value). The router runs every CSP callback, including
	  the libparam server, so it sits above the F Prime tasks: cmdDisp 44,
	  rateGroup_1Hz 43, cspLibparam 42.

config APP_CSP_UDP
	bool "Carry CSP over UDP on the Ethernet port instead of CAN"
	help
	  The bench server uses fprime-csp-libparam's UdpTransport to one peer
	  (CSP over UDP, as csh's `csp add udp`). Set by udp.conf, which also
	  enables the network stack with the board's static address.

if APP_CSP_UDP

config APP_CSP_UDP_PEER
	string "IPv4 address of the CSP over UDP peer"
	default "192.168.70.1"

config APP_CSP_UDP_PORT
	int "UDP port the bench server receives on"
	range 1 65535
	default 9220

config APP_CSP_UDP_PEER_PORT
	int "UDP port of the peer"
	range 1 65535
	default 9220

endif # APP_CSP_UDP

config APP_BOOT_CONFIG_ADDR
	hex "Physical address where U-Boot leaves te0715.txt"
	default 0x0f000000
	help
	  boot/boot.cmd loads te0715.txt from the SD card to this address plus
	  0x100, and writes a magic word and the file length in front of it.
	  Must lie in RAM that neither U-Boot nor Zephyr uses; must match
	  boot.cmd.

source "Kconfig.zephyr"
```

## app/apps/fprime_ina229_bench/Kconfig
```kconfig
# SPDX-License-Identifier: Apache-2.0

mainmenu "INA229 bench on the TE0715"

config APP_SPI_FREQUENCY
	int "Requested SPI clock in Hz at boot"
	range 558035 10000000
	default 1200000
	help
	  The Zynq SPI controller divides SPI_REF_CLK (142.86 MHz) by 4 to 256;
	  the driver picks the fastest division that does not exceed this
	  request. 1.2 MHz selects 1.116 MHz. Change it at run time with
	  `ina spi`.

config APP_SPI_MODE
	int "SPI mode at boot"
	range 0 3
	default 3
	help
	  SPI mode 3 (CPOL 1, CPHA 1), the only mode in which every register
	  write reached the INA229 on this bench (2026-10-04). In modes 1 and 2
	  reads pass but some writes are silently lost, depending on the data
	  bits; mode 0 breaks reads (docs/known-issues.md). Change it at run
	  time with `ina spi`.

source "Kconfig.zephyr"
```

## app/dts/bindings/spi/xlnx,zynq-spi-r1p6.yaml
```yaml
# SPDX-License-Identifier: Apache-2.0

description: |
  Zynq-7000 PS SPI controller (Cadence IP, revision r1p6).

  Zephyr's cdns,spi driver serves this controller; list "cdns,spi" as the second
  compatible. This binding adds the pin configuration properties, so board code
  can apply the controller's MIO pin state: the driver itself does not apply
  pinctrl (see app/boards/trenz/te0715/board.c).

compatible: "xlnx,zynq-spi-r1p6"

include:
  - "cdns,spi.yaml"
  - pinctrl-device.yaml
```

## app/tests/bench/testcase.yaml
```yaml
common:
  tags: te0715
  integration_platforms:
    - native_sim/native/64
tests:
  te0715.bench:
    platform_allow:
      - native_sim
      - native_sim/native/64
      - te0715
```

## app/zephyr/Kconfig
```kconfig
# SPDX-License-Identifier: Apache-2.0

config LIBPARAM
	bool "Space Inventor libparam"
	depends on LIBCSP
	depends on PICOLIBC
	help
	  Build Space Inventor libparam (csh/2.10) from modules/lib/libparam,
	  with the same source set and dynamic parameter list profile as the
	  Linux fprime-csp-libparam build. Parameters are registered at run
	  time with param_list_add(); the static "param" linker section is not
	  supported. The dynamic list allocates with malloc(), so the C library
	  heap must be large enough (CONFIG_COMMON_LIBC_MALLOC_ARENA_SIZE).
```

## boards/trenz/te0715/Kconfig.te0715
```kconfig
# Trenz Electronics TE0715 board configuration

# Author: Sibo Van Gool <sibo.vangool@kuleuven.be>

config BOARD_TE0715
    select SOC_XC7Z030
```

## boards/trenz/te0715/board.yml
```yaml
board:
  name: te0715
  full_name: TE0715-05-71I33-L
  vendor: trenz
  socs:
    - name: xc7z015
```
