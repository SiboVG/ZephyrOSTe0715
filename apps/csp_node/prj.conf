## Kconfig
```
# SPDX-License-Identifier: Apache-2.0

mainmenu "TE0715 CSP node"

config APP_CSP_NODE
	int "Local CSP node address"
	range 1 16381
	default 101

config APP_CSP_PEER
	int "CSP node to ping (0: do not ping)"
	range 0 16381
	default 100

config APP_CSP_NETMASK
	int "CSP network prefix length"
	range 0 13
	default 8

config APP_CSP_PING_PERIOD_MS
	int "Ping period in milliseconds"
	default 2000

config APP_PARAM_ID
	int "ID of the libparam test parameter (bench_integer, uint32)"
	range 0 65535
	default 200

config APP_PARAM_VALUE
	hex "Initial value of the libparam test parameter"
	default 0x12345678

source "Kconfig.zephyr"
```

## prj.conf
```kconfig
CONFIG_CAN=y
CONFIG_LIBCSP=y
# Needed by the POSIX timer options libcsp selects
CONFIG_POSIX_SYSTEM_INTERFACES=y
CONFIG_CSP_HAVE_CAN=y
CONFIG_CSP_CAN_RX_THREAD_STACK_SIZE=2048
# The libcsp Zephyr CAN interface allocates its context from the system heap
CONFIG_HEAP_MEM_POOL_SIZE=8192
CONFIG_PICOLIBC=y
CONFIG_EVENTS=y
CONFIG_MAIN_STACK_SIZE=4096
CONFIG_LOG=y
CONFIG_PRINTK=y
CONFIG_LIBPARAM=y
# The dynamic libparam list allocates with malloc()
CONFIG_COMMON_LIBC_MALLOC_ARENA_SIZE=16384
```

## src/main.c
```c
/*
 * CSP node on the TE0715 CAN1 (TE0701 Pmod J1), set up like the Linux
 * fprime-csp-libparam SocketCAN transport: CSP v2, the CAN interface as the
 * default route, and the standard CSP services (ping, ident, ...) on all
 * ports. It also pings CONFIG_APP_CSP_PEER periodically.
 *
 * It is also a libparam server like `CspBench --role server`: one uint32
 * parameter "bench_integer" (CONFIG_APP_PARAM_ID) served on PARAM_PORT_SERVER.
 */

#include <csp/csp.h>
#include <csp/drivers/can_zephyr.h>
#include <param/param.h>
#include <param/param_list.h>
#include <param/param_server.h>
#include <zephyr/device.h>
#include <zephyr/kernel.h>
#include <zephyr/sys/printk.h>

#define ROUTER_STACK_SIZE 4096
#define ROUTER_PRIORITY   5

static const struct device *const can_dev = DEVICE_DT_GET(DT_CHOSEN(zephyr_canbus));

static uint32_t param_value = CONFIG_APP_PARAM_VALUE;
static uint16_t param_node; /* 0: local parameter */
static csp_timestamp_t param_timestamp;

static void param_changed(param_t *param, int offset)
{
	printk("PARAM %s = 0x%08x (written remotely)\n", param->name,
	       param_get_uint32_array(param, offset));
}

static param_t bench_integer = {
	.id = CONFIG_APP_PARAM_ID,
	.node = &param_node,
	.type = PARAM_TYPE_UINT32,
	.mask = PM_CONF,
	.name = "bench_integer",
	.unit = "raw",
	.docstr = "CSP/libparam bench integer",
	.addr = &param_value,
	.array_size = 1,
	.array_step = sizeof(uint32_t),
	.timestamp = &param_timestamp,
	.callback = param_changed,
};

static void router_thread(void *p1, void *p2, void *p3)
{
	ARG_UNUSED(p1);
	ARG_UNUSED(p2);
	ARG_UNUSED(p3);

	while (true) {
		(void)csp_route_work();
	}
}

K_THREAD_DEFINE(router, ROUTER_STACK_SIZE, router_thread, NULL, NULL, NULL, ROUTER_PRIORITY, 0,
		SYS_FOREVER_MS);

int main(void)
{
	csp_iface_t *iface = NULL;
	uint32_t pings = 0;
	uint32_t replies = 0;
	int err;

	if (!device_is_ready(can_dev)) {
		printk("CAN device %s not ready\n", can_dev->name);
		return 0;
	}

	csp_conf.version = 2;
	csp_conf.hostname = "te0715";
	csp_conf.model = "TE0715-05-71I33-L";
	csp_conf.revision = "zephyr";
	csp_init();

	err = csp_can_open_and_add_interface(can_dev, "CAN", CONFIG_APP_CSP_NODE,
					     DT_PROP(DT_CHOSEN(zephyr_canbus), bitrate),
					     CONFIG_APP_CSP_NODE, 0x3FFF, &iface);
	if (err != CSP_ERR_NONE) {
		printk("failed to add CSP CAN interface (err %d)\n", err);
		return 0;
	}
	iface->netmask = CONFIG_APP_CSP_NETMASK;
	iface->is_default = 1;

	err = param_list_add(&bench_integer);
	if (err < 0) {
		printk("failed to add libparam parameter (err %d)\n", err);
		return 0;
	}

	err = csp_bind_callback(param_serve, PARAM_PORT_SERVER);
	if (err != CSP_ERR_NONE) {
		printk("failed to bind libparam server (err %d)\n", err);
		return 0;
	}

	err = csp_bind_callback(csp_service_handler, CSP_ANY);
	if (err != CSP_ERR_NONE) {
		printk("failed to bind CSP service handler (err %d)\n", err);
		return 0;
	}

	k_thread_start(router);

	printk("CSP node %d/%d on %s, pinging %d every %d ms\n", CONFIG_APP_CSP_NODE,
	       CONFIG_APP_CSP_NETMASK, can_dev->name, CONFIG_APP_CSP_PEER,
	       CONFIG_APP_CSP_PING_PERIOD_MS);
	printk("libparam server on port %d: %s (id %d) = 0x%08x\n", PARAM_PORT_SERVER,
	       bench_integer.name, bench_integer.id, param_get_uint32(&bench_integer));

	while (CONFIG_APP_CSP_PEER != 0) {
		int rtt = csp_ping(CONFIG_APP_CSP_PEER, 1000, 32, CSP_O_NONE);

		pings++;
		if (rtt >= 0) {
			replies++;
		}
		printk("PING %d: %s %d ms (%u/%u replies)\n", CONFIG_APP_CSP_PEER,
		       rtt >= 0 ? "reply in" : "no reply, err", rtt, replies, pings);

		k_msleep(CONFIG_APP_CSP_PING_PERIOD_MS);
	}

	return 0;
}
```
